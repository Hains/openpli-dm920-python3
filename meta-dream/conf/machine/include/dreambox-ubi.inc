## meta-openpli/conf/distro/reporefs.conf
```bitbake
# E2 plugins
SRCREV_pn-enigma2-plugins = "${AUTOREV}"
SRCREV_pn-enigma2-plugin-extensions-backupsuite = "${AUTOREV}"
SRCREV_pn-enigma2-plugin-extensions-blurayplayer = "${AUTOREV}"
SRCREV_pn-enigma2-plugin-extensions-dlnabrowser = "${AUTOREV}"
SRCREV_pn-enigma2-plugin-extensions-dlnaserver = "${AUTOREV}"
SRCREV_pn-enigma2-plugin-extensions-epgimport = "${AUTOREV}"
SRCREV_pn-enigma2-plugin-extensions-historyzapselector = "${AUTOREV}"
SRCREV_pn-enigma2-plugin-extensions-iptvplayer = "${AUTOREV}"
SRCREV_pn-enigma2-plugin-extensions-lcd4linux = "${AUTOREV}"
SRCREV_pn-enigma2-plugin-extensions-managerautofs = "${AUTOREV}"
SRCREV_pn-enigma2-plugin-extensions-modifyplifullhd = "${AUTOREV}"
SRCREV_pn-enigma2-plugin-extensions-moviemanager = "${AUTOREV}"
SRCREV_pn-enigma2-plugin-extensions-refreshbouquet= "${AUTOREV}"
SRCREV_pn-enigma2-plugin-extensions-subssupport = "${AUTOREV}"
SRCREV_pn-enigma2-plugin-extensions-tmbd = "${AUTOREV}"
SRCREV_pn-enigma2-plugin-extensions-vcs = "${AUTOREV}"
SRCREV_pn-enigma2-plugin-extensions-xmodem = "${AUTOREV}"
SRCREV_pn-enigma2-plugin-extensions-youtube = "${AUTOREV}"

# Systemplugins
SRCREV_pn-enigma2-plugin-systemplugins-extnumberzap = "${AUTOREV}"
SRCREV_pn-enigma2-plugin-systemplugins-hrtunerproxy = "${AUTOREV}"
SRCREV_pn-enigma2-plugin-systemplugins-mountmanager = "${AUTOREV}"
SRCREV_pn-enigma2-plugin-systemplugins-serviceapp = "${AUTOREV}"
SRCREV_pn-enigma2-plugin-systemplugins-signalfinder = "${AUTOREV}"
SRCREV_pn-enigma2-plugin-systemplugins-quadpip = "${AUTOREV}"

# Settings
SRCREV_pn-enigma2-plugin-settings-hans-13e-19e-23e-28e = "${AUTOREV}"
SRCREV_pn-enigma2-plugin-settings-hans-9e-13e-19e-23e-28e = "${AUTOREV}"
SRCREV_pn-enigma2-plugin-settings-hans-9e-13e-19e-23e-28e-rotating = "${AUTOREV}"
SRCREV_pn-enigma2-plugin-settings-hans-19e-23e-28e = "${AUTOREV}"
SRCREV_pn-enigma2-plugin-settings-hans-19e-23e-basis = "${AUTOREV}"
SRCREV_pn-enigma2-plugin-settings-hans-19e-23e = "${AUTOREV}"
SRCREV_pn-enigma2-plugin-settings-hans-kabelnl = "${AUTOREV}"

# Plugins
SRCREV_pn-aio-grab = "${AUTOREV}"
SRCREV_pn-astra-sm = "${AUTOREV}"
SRCREV_pn-bitstream = "${AUTOREV}"
SRCREV_pn-cdparanoia = "19651"
SRCREV_pn-dcadec = "${AUTOREV}"
SRCREV_pn-dvblast = "${AUTOREV}"
SRCREV_pn-dvbsnoop = "${AUTOREV}"
SRCREV_pn-dvdauthor = "${AUTOREV}"
SRCREV_pn-exteplayer3 = "${AUTOREV}"
SRCREV_pn-f4mdump = "${AUTOREV}"
SRCREV_pn-gst-ifdsrc = "${AUTOREV}"
SRCREV_pn-gstplayer = "${AUTOREV}"
SRCREV_pn-hlsdl = "${AUTOREV}"
SRCREV_pn-iptvsubparser = "${AUTOREV}"
SRCREV_pn-libaacs = "${AUTOREV}"
SRCREV_pn-libbluray = "${AUTOREV}"
SRCREV_pn-libdreamdvd = "${AUTOREV}"
SRCREV_pn-libdvbcsa = "${AUTOREV}"
SRCREV_pn-libdvbsi++ = "${AUTOREV}"
SRCREV_pn-libdvdnav = "${AUTOREV}"
SRCREV_pn-libdvdread = "${AUTOREV}"
SRCREV_pn-libsquish = "${AUTOREV}"
SRCREV_pn-libtuxtxt = "${AUTOREV}"
SRCREV_pn-libudfread = "${AUTOREV}"
SRCREV_pn-lsdir = "${AUTOREV}"
SRCREV_pn-minisatip = "${AUTOREV}"
SRCREV_pn-python-transmissionrpc = "${AUTOREV}"
SRCREV_pn-shairplay = "${AUTOREV}"
SRCREV_pn-readymedia = "${AUTOREV}"
SRCREV_pn-tuxbox-common = "${AUTOREV}"
SRCREV_pn-tuxtxt-enigma2 = "${AUTOREV}"
SRCREV_pn-uchardet = "${AUTOREV}"
SRCREV_pn-udpxy = "${AUTOREV}"
SRCREV_pn-upscaledb = "${AUTOREV}"

# Firmwares
SRCREV_pn-firmware-af9005 = "${AUTOREV}"
SRCREV_pn-firmware-as102-data1-st = "${AUTOREV}"
SRCREV_pn-firmware-as102-data2-st = "${AUTOREV}"
SRCREV_pn-firmware-atheros-ar9271 = "${AUTOREV}"
SRCREV_pn-firmware-carl9170 = "${AUTOREV}"
SRCREV_pn-firmware-cx231xx = "${AUTOREV}"
SRCREV_pn-firmware-drx397xd.a2 = "${AUTOREV}"
SRCREV_pn-firmware-drx397xd.b1 = "${AUTOREV}"
SRCREV_pn-firmware-drxd-a2-1.1 = "${AUTOREV}"
SRCREV_pn-firmware-drxd-b1-1.1 = "${AUTOREV}"
SRCREV_pn-firmware-htc7010 = "${AUTOREV}"
SRCREV_pn-firmware-htc9271 = "${AUTOREV}"
SRCREV_pn-firmware-isdbt-nova-12mhz-b0 = "${AUTOREV}"
SRCREV_pn-firmware-marvell-sd8688 = "${AUTOREV}"
SRCREV_pn-firmware-mt7601u = "${AUTOREV}"
SRCREV_pn-firmware-rt2870 = "${AUTOREV}"
SRCREV_pn-firmware-rt73 = "${AUTOREV}"
SRCREV_pn-firmware-rtl8xxxu = "${AUTOREV}"
SRCREV_pn-firmware-rtl8188eu = "${AUTOREV}"
SRCREV_pn-firmware-rtl8192cu = "${AUTOREV}"
SRCREV_pn-firmware-rtl8192eu = "${AUTOREV}"
SRCREV_pn-firmware-rtl8712u = "${AUTOREV}"
SRCREV_pn-firmware-sms1xxx-hcw-114xxx-cmmb-01 = "${AUTOREV}"
SRCREV_pn-firmware-sms1xxx-hcw-55xxx-dvbt-01 = "${AUTOREV}"
SRCREV_pn-firmware-sms1xxx-hcw-55xxx-dvbt-02 = "${AUTOREV}"
SRCREV_pn-firmware-sms1xxx-hcw-55xxx-dvbt-03 = "${AUTOREV}"
SRCREV_pn-firmware-sms1xxx-hcw-55xxx-isdbt-02 = "${AUTOREV}"
SRCREV_pn-firmware-sms1xxx-hcw-55xxx-isdbt-03 = "${AUTOREV}"
SRCREV_pn-firmware-sms1xxx-nova-a-dvbt-01 = "${AUTOREV}"
SRCREV_pn-firmware-sms1xxx-nova-b-dvbt-01 = "${AUTOREV}"
SRCREV_pn-firmware-xc3028-dvico-au-01 = "${AUTOREV}"
SRCREV_pn-firmware-xc3028-v27 = "${AUTOREV}"
SRCREV_pn-firmware-xc3028l-v36 = "${AUTOREV}"
SRCREV_pn-firmware-xc5000 = "${AUTOREV}"
SRCREV_pn-firmware-xc5000c = "${AUTOREV}"
SRCREV_pn-firmware-zd1211 = "${AUTOREV}"
SRCREV_pn-firmware-dvb-demod-m88ds3103 = "${AUTOREV}"
SRCREV_pn-firmware-dvb-demod-mn88473-01 = "${AUTOREV}"
SRCREV_pn-firmware-dvb-demod-si2168-a20 = "${AUTOREV}"
SRCREV_pn-firmware-dvb-demod-si2168-a30 = "${AUTOREV}"
SRCREV_pn-firmware-dvb-demod-si2168-b40 = "${AUTOREV}"
SRCREV_pn-firmware-dvb-fe-af9013 = "${AUTOREV}"
SRCREV_pn-firmware-dvb-fe-ds3000 = "${AUTOREV}"
SRCREV_pn-firmware-dvb-fe-tda10071 = "${AUTOREV}"
SRCREV_pn-firmware-dvb-fe-xc5000-1.1 = "${AUTOREV}"
SRCREV_pn-firmware-dvb-fe-xc5000-1.6.114 = "${AUTOREV}"
SRCREV_pn-firmware-dvb-nova-12mhz-b0 = "${AUTOREV}"
SRCREV_pn-firmware-dvb-siano = "${AUTOREV}"
SRCREV_pn-firmware-dvb-tuner-si2158-a20 = "${AUTOREV}"
SRCREV_pn-firmware-dvb-usb-adstech-usb2-02 = "${AUTOREV}"
SRCREV_pn-firmware-dvb-usb-af9015 = "${AUTOREV}"
SRCREV_pn-firmware-dvb-usb-af9035-01 = "${AUTOREV}"
SRCREV_pn-firmware-dvb-usb-af9035-02 = "${AUTOREV}"
SRCREV_pn-firmware-dvb-usb-avertv-a800-02 = "${AUTOREV}"
SRCREV_pn-firmware-dvb-usb-bluebird-01 = "${AUTOREV}"
SRCREV_pn-firmware-dvb-usb-bluebird-02 = "${AUTOREV}"
SRCREV_pn-firmware-dvb-usb-dib0700-01 = "${AUTOREV}"
SRCREV_pn-firmware-dvb-usb-dib0700-03-pre1 = "${AUTOREV}"
SRCREV_pn-firmware-dvb-usb-dib0700-1.10 = "${AUTOREV}"
SRCREV_pn-firmware-dvb-usb-dib0700-1.20 = "${AUTOREV}"
SRCREV_pn-firmware-dvb-usb-dibusb-5.0.0.11 = "${AUTOREV}"
SRCREV_pn-firmware-dvb-usb-dibusb-6.0.0.8 = "${AUTOREV}"
SRCREV_pn-firmware-dvb-usb-dibusb-an2235-01 = "${AUTOREV}"
SRCREV_pn-firmware-dvb-usb-digitv-02 = "${AUTOREV}"
SRCREV_pn-firmware-dvb-usb-digivox-02 = "${AUTOREV}"
SRCREV_pn-firmware-dvb-usb-dposh-01 = "${AUTOREV}"
SRCREV_pn-firmware-dvb-usb-dtt200u-01 = "${AUTOREV}"
SRCREV_pn-firmware-dvb-usb-ec168 = "${AUTOREV}"
SRCREV_pn-firmware-dvb-usb-it9135 = "${AUTOREV}"
SRCREV_pn-firmware-dvb-usb-it913x = "${AUTOREV}"
SRCREV_pn-firmware-dvb-usb-megasky-02 = "${AUTOREV}"
SRCREV_pn-firmware-dvb-usb-nova-t-usb2-01 = "${AUTOREV}"
SRCREV_pn-firmware-dvb-usb-nova-t-usb2-02 = "${AUTOREV}"
SRCREV_pn-firmware-dvb-usb-s660 = "${AUTOREV}"
SRCREV_pn-firmware-dvb-usb-technisat-skystar = "${AUTOREV}"
SRCREV_pn-firmware-dvb-usb-tvwalkert = "${AUTOREV}"
SRCREV_pn-firmware-dvb-usb-umt-010-02 = "${AUTOREV}"
SRCREV_pn-firmware-dvb-usb-wt220u-02 = "${AUTOREV}"
SRCREV_pn-firmware-dvb-usb-wt220u-fc03 = "${AUTOREV}"
SRCREV_pn-firmware-dvb-usb-wt220u-miglia-01 = "${AUTOREV}"
SRCREV_pn-firmware-dvb-usb-wt220u-zl0353-01 = "${AUTOREV}"

# Multiboot
SRCREV_pn-openmultiboot = "${AUTOREV}"
SRCREV_pn-enigma2-plugin-extensions-openmultiboot = "${AUTOREV}"

SRCREV_pn-satipclient = "${AUTOREV}"

# Enigma2
SRCREV_pn-enigma2 = "${AUTOREV}"
SRCREV_pn-enigma2-plugin-systemplugins-servicemp3 = "${AUTOREV}"
SRCREV_pn-hotplug-e2-helper = "${AUTOREV}"

# PLiplugins
SRCREV_pn-enigma2-pliplugins = "${AUTOREV}"

# Skins
SRCREV_pn-enigma2-skins = "${AUTOREV}"
SRCREV_pn-enigma2-plugin-skins-pli-hd = "${AUTOREV}"
SRCREV_pn-enigma2-plugin-skins-pli-hd-fullnight = "${AUTOREV}"
SRCREV_pn-enigma2-plugin-skins-magic = "${AUTOREV}"
SRCREV_pn-enigma2-plugin-skins-pd1loi-hd-night = "${AUTOREV}"
SRCREV_pn-enigma2-plugin-skins-simple-gray-hd = "${AUTOREV}"

# Picons
SRCREV_pn-enigma2-plugin-picons-srp-grey-border-9.0-13-19.2-23.5-28.2-satellite-100x60 = "${AUTOREV}"
SRCREV_pn-enigma2-plugin-picons-srp-grey-border-9.0-13-19.2-23.5-28.2-satellite-220x132 = "${AUTOREV}"
SRCREV_pn-enigma2-plugin-picons-ziggo.metal-stamp-220x132 = "${AUTOREV}"
SRCREV_pn-enigma2-plugin-picons-ziggo.black-white-220x132 = "${AUTOREV}"
SRCREV_pn-enigma2-plugin-picons-ziggo.black-button-220x132 = "${AUTOREV}"
SRCREV_pn-enigma2-plugin-picons-ziggo.reflection-black-220x132 = "${AUTOREV}"
SRCREV_pn-enigma2-plugin-picons-ziggo.transparent-white-220x132 = "${AUTOREV}"
SRCREV_pn-enigma2-plugin-picons-ziggo.metal-look-100x60 = "${AUTOREV}"
SRCREV_pn-enigma2-plugin-picons-ziggo.metal-look-220x132 = "${AUTOREV}"
SRCREV_pn-enigma2-plugin-picons-ziggo.metal-stamp-100x60 = "${AUTOREV}"

# rtl8188/8192
SRCREV_pn-rtl8188eu = "${AUTOREV}"
SRCREV_pn-rtl8192eu = "${AUTOREV}"

# Softcams
SRCREV_pn-enigma2-plugin-softcams-oscam = "11432"
SRCREV_pn-enigma2-plugin-softcams-oscam-emu = "11432"

SRCREV_pn-blindscan-s2 = "${AUTOREV}"

# e2openplugins
SRCREV_pn-enigma2-plugin-extensions-addstreamurl = "${AUTOREV}"
SRCREV_pn-enigma2-plugin-extensions-analogclock = "${AUTOREV}"
SRCREV_pn-enigma2-plugin-extensions-antilogo = "${AUTOREV}"
SRCREV_pn-enigma2-plugin-extensions-autobackup = "${AUTOREV}"
SRCREV_pn-enigma2-plugin-extensions-autobouquets = "${AUTOREV}"
SRCREV_pn-enigma2-plugin-extensions-bhtunerserver = "${AUTOREV}"
SRCREV_pn-enigma2-plugin-extensions-bitrate = "${AUTOREV}"
SRCREV_pn-enigma2-plugin-extensions-buienradar = "${AUTOREV}"
SRCREV_pn-enigma2-plugin-extensions-cacheflush = "${AUTOREV}"
SRCREV_pn-enigma2-plugin-extensions-changerootpassword = "${AUTOREV}"
SRCREV_pn-enigma2-plugin-extensions-epgimportfilter = "${AUTOREV}"
SRCREV_pn-enigma2-plugin-extensions-fontinfo = "${AUTOREV}"
SRCREV_pn-enigma2-plugin-extensions-foreca = "${AUTOREV}"
SRCREV_pn-enigma2-plugin-extensions-hetweer = "${AUTOREV}"
SRCREV_pn-enigma2-plugin-extensions-meteoitalia = "${AUTOREV}"
SRCREV_pn-enigma2-plugin-extensions-meteoviewer = "${AUTOREV}"
SRCREV_pn-enigma2-plugin-extensions-newsreader = "${AUTOREV}"
SRCREV_pn-enigma2-plugin-extensions-nfsserver = "${AUTOREV}"
SRCREV_pn-enigma2-plugin-extensions-oggisport = "${AUTOREV}"
SRCREV_pn-enigma2-plugin-extensions-openairplay = "${AUTOREV}"
SRCREV_pn-enigma2-plugin-extensions-openwebif = "${AUTOREV}"
SRCREV_pn-enigma2-plugin-extensions-oroscopoitalia = "${AUTOREV}"
SRCREV_pn-enigma2-plugin-extensions-oscamstatus = "${AUTOREV}"
SRCREV_pn-enigma2-plugin-extensions-permanentvfdclock = "${AUTOREV}"
SRCREV_pn-enigma2-plugin-extensions-ppanel = "${AUTOREV}"
SRCREV_pn-enigma2-plugin-extensions-remotecontrolchannel = "${AUTOREV}"
SRCREV_pn-enigma2-plugin-extensions-remotestreamconvert = "${AUTOREV}"
SRCREV_pn-enigma2-plugin-extensions-screenposition = "${AUTOREV}"
SRCREV_pn-enigma2-plugin-extensions-setpicon = "${AUTOREV}"
SRCREV_pn-enigma2-plugin-extensions-shootyourscreen = "${AUTOREV}"
SRCREV_pn-enigma2-plugin-extensions-simpleumount = "${AUTOREV}"
SRCREV_pn-enigma2-plugin-extensions-snmpagent = "${AUTOREV}"
SRCREV_pn-enigma2-plugin-extensions-streaminterface = "${AUTOREV}"
SRCREV_pn-enigma2-plugin-extensions-systemtools = "${AUTOREV}"
SRCREV_pn-enigma2-plugin-extensions-telekomsport = "${AUTOREV}"
SRCREV_pn-enigma2-plugin-extensions-usbformatwizard = "${AUTOREV}"
SRCREV_pn-enigma2-plugin-extensions-wakeonlan = "${AUTOREV}"
SRCREV_pn-enigma2-plugin-extensions-xpower = "${AUTOREV}"
SRCREV_pn-enigma2-plugin-systemplugins-autobouquetsmaker = "${AUTOREV}"
SRCREV_pn-enigma2-plugin-systemplugins-autoshutdown = "${AUTOREV}"
SRCREV_pn-enigma2-plugin-systemplugins-crossepg = "${AUTOREV}"
SRCREV_pn-enigma2-plugin-systemplugins-extrafancontrol = "${AUTOREV}"

# OPKG
SRCREV_pn-opkg ="99c657292194b09e96cba758883e214ff2d97901"

# Gstreamer 1.x
SRCREV_base_pn-gstreamer1.0 = "54e498f2d57ceeed7a68e274e5c3786b4afdc9c0"
SRCREV_common_pn-gstreamer1.0 = "46d420818ed8172022caf4503894076b18b1e153"
SRCREV_base_pn-gstreamer1.0-plugins-base = "cfc8d7ec9e37cf766e787a93af5bb4a6ea5b49fa"
SRCREV_common_pn-gstreamer1.0-plugins-base = "46d420818ed8172022caf4503894076b18b1e153"
SRCREV_base_pn-gstreamer1.0-plugins-good = "9605028a712ac83252072f8abc4bd17743c1e611"
SRCREV_common_pn-gstreamer1.0-plugins-good = "46d420818ed8172022caf4503894076b18b1e153"
SRCREV_base_pn-gstreamer1.0-plugins-bad = "23feed75455bf5efee64857ffa03af8b4e281208"
SRCREV_common_pn-gstreamer1.0-plugins-bad = "46d420818ed8172022caf4503894076b18b1e153"
SRCREV_base_pn-gstreamer1.0-plugins-ugly = "7e639433617c4e3969ed27b600f0508e4d7252b8"
SRCREV_common_pn-gstreamer1.0-plugins-ugly = "46d420818ed8172022caf4503894076b18b1e153"
SRCREV_base_pn-gstreamer1.0-libav = "46cc79c43a95108967ffa041145b8117b5e49589"
SRCREV_pn-gstreamer1.0-plugin-multibox-dvbmediasink = "${AUTOREV}"
SRCREV_pn-gstreamer1.0-plugin-subsink = "${AUTOREV}"

# FFmpeg 4.x
SRCREV_pn-ffmpeg = "59256dea146d2b6c163f0e3205adda0cbc21c0c4
```

## meta-openpli/conf/layer.conf
```bitbake
# We have a conf and classes directory, append to BBPATH
BBPATH .= ":${LAYERDIR}"

# We have a recipes directory, add to BBFILES
BBFILES += "${LAYERDIR}/recipes-*/*/*.bb ${LAYERDIR}/recipes-*/*/*.bbappend"

BBFILE_COLLECTIONS += "openpli-layer"
BBFILE_PATTERN_openpli-layer := "^${LAYERDIR}/"
BBFILE_PRIORITY_openpli-layer = "7"

OPENPLI_BASE := '${@os.path.normpath("${LAYERDIR}/../")}'
# Prevent current directory creeping into sstate objects. Otherwise, building
# in another TOPDIR will cause recipes using this variable to be rebuilt.
OPENPLI_BASE[vardepvalue] = 'meta-openpli'

LICENSE_PATH += "${LAYERDIR}/licenses"

INSANE_SKIP_${PN} += "already-stripped"

#Include glib-gettextize, subversion and msgfmt(gettext) to hosttools
HOSTTOOLS += "glib-gettextize svn msgfmt"

MACHINE="dm8000"

LAYERSERIES_COMPAT_local-layer = "warrior"
LAYERSERIES_COMPAT_meta-python = "warrior"
LAYERSERIES_COMPAT_openembedded-layer = "warrior"
LAYERSERIES_COMPAT_openpli-layer = "warrior"

# This prevents bitbake to fail at do_package caused by default OE-core split style variable setting
PACKAGE_DEBUG_SPLIT_STYLE = ""
```
