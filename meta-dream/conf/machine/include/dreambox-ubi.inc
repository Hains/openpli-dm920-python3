## meta-dream/conf/machine/include/dreambox-ubi.inc
```bitbake
inherit image_types_nfi

IMAGE_FSTYPES ?= "ubi"
UBI_VOLNAME = "rootfs"
UBINIZE_VOLSIZE ?= "0"
UBINIZE_DATAVOL ?= "0"
```

## meta-dreambox/conf/machine/dm920.conf
```bitbake
#@TYPE: Machine
#@NAME: Dreambox DM920
#@DESCRIPTION: Machine configuration for the Dreambox DM920

MACHINE_FEATURES += "modem kernelwifi dvb-c blindscan-dvbc hdmicec recovery ci dvd usbconsole"

CHIPSET = "bcm7252s"
SOC_FAMILY = "bcm7252s"

require conf/machine/include/dreambox-arm.inc
```

## meta-dreambox/conf/machine/include/dreambox-arm.inc
```bitbake
# dreambox-arm.inc

MTD_ROOTFS = "mmcblk0p2"
MTD_KERNEL = "mmcblk0p1"
KERNEL_FILE = "kernel.bin"
ROOTFS_FILE = "rootfs.tar.bz2"

DISTRO_FEATURES_GFX:mipsel ?= " opengl"

PACKAGECONFIG:pn-glmark2 = "gles2"

PACKAGECONFIG:pn-cogl-1.0 = "egl-kms egl-null \
        ${@bb.utils.contains('DISTRO_FEATURES', 'opengl', 'gles2', '', d)}"

PACKAGECONFIG:pn-weston = "${@bb.utils.contains('DISTRO_FEATURES', 'opengl', 'gles', '', d)}"

DVBSKYPROVIDER = "kernel"

GLIBC_EXTRA_OECONF = "--with-tls --with-__thread"

DVBMEDIASINK_CONFIG = "--with-machine=${MACHINE} --with-pcm --with-wma --with-wmv --with-dts=no --with-dtsdownmix --with-eac3 --with-vb6 --with-vb8 --with-vb9 --with-spark --with-h265"

require conf/machine/include/soc-family.inc
require conf/machine/include/arm/armv7a/tune-cortexa15.inc

MACHINE_EXTRA_RRECOMMENDS += "\
    gstreamer1.0-plugin-multibox-dvbmediasink \
    gstreamer1.0-libav \
    kernel-module-cifs \
    kernel-module-autofs4 \
    kernel-module-hmac \
    kernel-module-md4 \
    kernel-module-ecb \
    kernel-module-fuse \
    kernel-module-nfsd \
    kernel-module-exportfs \
    kernel-module-snd-oss \
    kernel-module-snd-pcm-oss \
    "

MACHINE_ESSENTIAL_EXTRA_RDEPENDS += "\
    dreambox-dvb-modules-${MACHINE} \
    libpagecache \
    libpassthrough \
    "

KERNEL_MODULE_AUTOLOAD += "xfs"

DISTRO_FEATURES:remove = "directfb gtk-directfb"
    
MACHINE_FEATURES += "dreambox alsa usbhost 3dtv switchoff blindscan-dvbs"
# Add "dreambox" override for recipes
MACHINEOVERRIDES .= ":dreambox"

PREFERRED_PROVIDER_virtual/kernel = "linux-dreambox"
PREFERRED_PROVIDER_virtual/blindscan-dvbs = "dreambox-blindscan-utils"
PREFERRED_PROVIDER_virtual/blindscan-dvbc = "dreambox-blindscan-utils"
PREFERRED_VERSION_linux-dreambox ?= "3.14"
PREFERRED_PROVIDER_virtual/libgl ?= "mesa-gl"
PREFERRED_PROVIDER_virtual/mesa ?= "mesa-gl"
PREFERRED_VERSION_linux-dreambox = "3.14"

TARGET_ARCH = "arm"
DEFAULTTUNE = "cortexa15hf-neon-vfpv4"
OLDEST_KERNEL = "3.14"

MACHINE_FEATURES_BACKFILL_CONSIDERED = "rtc gobject-introspection-data"

DREAMBOX_IMAGE_SIZE ??= "1024"

IMAGE_FSTYPES =+ "tar.bz2"

IMAGE_CLASSES += "image_types_tarbz2"
```

## meta-kodi/conf/layer.conf
```bitbake
# We have a conf and classes directory, append to BBPATH
BBPATH .= ":${LAYERDIR}"

# We have a recipes directory, add to BBFILES
BBFILES += "${LAYERDIR}/recipes-*/*.bb ${LAYERDIR}/recipes-*/*.bbappend \
            ${LAYERDIR}/recipes-*/*/*.bb ${LAYERDIR}/recipes-*/*/*.bbappend \
            ${LAYERDIR}/recipes-*/*/*/*.bb ${LAYERDIR}/recipes-*/*/*/*.bbappend"

METAKODI_BASE := '${@os.path.normpath("${LAYERDIR}/../")}'
# Prevent current directory creeping into sstate objects. Otherwise, building
# in another TOPDIR will cause recipes using this variable to be rebuilt.
METAKODI_BASE[vardepvalue] = 'meta-kodi'

# Additional license directories.
LICENSE_PATH += "${LAYERDIR}/conf/license"
```

## meta-openpli/conf/distro/openpli.conf
```bitbake
#@TYPE: Distribution
#@NAME: Open Vision
#@DESCRIPTION: Embedded Linux Distribution Configuration for STB's

require reporefs.conf

DISTRO_FEATURES_BACKFILL_CONSIDERED += "pulseaudio"

DISTRO_NAME ?= "openpli"
DISTRO_HOST ?= "${@os.uname()[1]}"
DISTRO_VERSION ?= "13.2"
DISTRO_TYPE ?= "release"

IPKG_VARIANT = "opkg"

FEED_NAME ?= "${DISTRO_NAME}-${DISTRO_VERSION}"
DISTRO_FEED_URI ?= "http://${DISTRO_HOST}/feeds/${FEED_NAME}"
DISTRO_FEED_PREFIX ?= "${DISTRO_NAME}"

IMAGE_NAME = "${IMAGE_BASENAME}-${DISTRO_VERSION}-${MACHINE}"
IMAGE_LINK_NAME = ""
CACHE ?= "${TMPDIR}/cache/${LIBC}/${MACHINE}"
DEPLOY_DIR ?= "${TMPDIR}/deploy/${LIBC}"
DEPLOY_DIR_IMAGE = "${DEPLOY_DIR}/images/${MACHINE}"

VIRTUAL-RUNTIME_dev_manager = "eudev"
VIRTUAL-RUNTIME_login_manager = "busybox"
VIRTUAL-RUNTIME_init_manager = "sysvinit"
VIRTUAL-RUNTIME_initscripts = "initscripts"

PREFERRED_PROVIDER_libcrypto = "openssl"
PREFERRED_PROVIDER_libssl = "openssl"

PREFERRED_PROVIDER_virtual/enigma2-mediaservice ?= "enigma2-plugin-systemplugins-servicemp3"

# Gstreamer 1.x
GST_VERSION = "1.0"

LICENSE_FLAGS_ACCEPTED = "commercial"
LICENSE_FLAGS_ACCEPTED = "commercial commercial_mpg123"
COMMERCIAL_AUDIO_PLUGINS ?= "gst-plugins-ugly-mad gst-plugins-ugly-mpegaudioparse"
COMMERCIAL_VIDEO_PLUGINS ?= "gst-plugins-ugly-mpeg2dec gst-plugins-ugly-mpegstream gst-plugins-bad-mpegvideoparse"

# OE optimization defaults to -O2.
# Override here to use -O3 instead for better performance.
FULL_OPTIMIZATION = "-O3 -pipe ${DEBUG_FLAGS}"

DISTRO_FEATURES ?= "alsa bluetooth directfb ext2 ipv4 ipv6 largefile nfs pam wifi zeroconf"

QA_LOGFILE = "${TMPDIR}/qa.log"

OEINCLUDELOGS ?= "yes"
KERNEL_CONSOLE ?= "ttyS0"

KERNEL_DEBUG_TIMESTAMPS = "1"

BB_GENERATE_MIRROR_TARBALLS ??= "0"

NO32LIBS ??= "1"

# Missing checksums should raise an error
BB_STRICT_CHECKSUM = "0"

# Place output in "tmp" as before, not "tmp-glibc"
TCLIBCAPPEND = ""

# Don't grab feeds for lower level archs, e.g. mips32el should not
# attempt to fetch mipsel, and armv7 need not fetch armv5 etcetera.
DISTRO_FEED_ARCHS = "all ${TUNE_PKGARCH} ${MACHINE_ARCH}"

# Use OpenSSL only
PACKAGECONFIG:pn-curl = "ipv6 openssl proxy zlib libssh2"
PACKAGECONFIG:pn-openldap = "ipv6 openssl modules mdb ldap meta null passwd proxycache dnssrv"
PACKAGECONFIG:pn-neon = "expat openssl libproxy webdav zlib"
```
